## sdkconfig.defaults
```kconfig
# ESP-IDF SDK Configuration for BosMag (ESP32-S3-MINI-1-N4R2)
# Minimal configuration for LoRa application only

# ===== Flash Configuration =====
CONFIG_ESPTOOLPY_FLASHSIZE_4MB=y
CONFIG_PARTITION_TABLE_CUSTOM=y
CONFIG_PARTITION_TABLE_CUSTOM_FILENAME="partitions_4mb.csv"

# ===== Compiler & Build =====
CONFIG_COMPILER_OPTIMIZATION_SIZE=y
CONFIG_COMPILER_OPTIMIZATION_PERF=n
CONFIG_COMPILER_OPTIMIZATION_ASSERTIONS_ENABLED=y

# ===== Console & Logging =====
CONFIG_ESP_CONSOLE_UART=y
CONFIG_ESP_CONSOLE_UART_NUM=0
CONFIG_ESP_CONSOLE_UART_BAUDRATE=115200
CONFIG_LOG_DEFAULT_LEVEL=3

# --- USB SERIAL/JTAG KONSOL AYARLARI ---

# Konsol çıkışını (printf, ESP_LOGI) UART0 yerine USB Serial/JTAG'e yönlendir
CONFIG_ESP_CONSOLE_USB_SERIAL_JTAG=y

# Standart USB Serial/JTAG sürücüsünü etkinleştir
CONFIG_USB_SERIAL_JTAG_DRIVER_ENABLED=y

# VFS (Virtual File System) üzerinden erişimi aç (stdin/stdout için)
CONFIG_VFS_SUPPORT_IO=y

# (İsteğe Bağlı) Bootloader loglarını da buraya basması için
CONFIG_ESP_CONSOLE_USB_SERIAL_JTAG_ENABLED=y

# ===== FreeRTOS =====
CONFIG_FREERTOS_HZ=1000
CONFIG_FREERTOS_CHECK_STACKOVERFLOW_DWORD=y

# ===== Power Management =====
CONFIG_PM_ENABLE=n

# ===== SPI Configuration =====
CONFIG_SPI_MASTER_IN_IRAM=n
CONFIG_SPI_MASTER_ISR_IN_IRAM=n

# ===== GPIO Configuration =====
CONFIG_GPIO_CTRL_PIN_SEARCH_ENABLED=n

# ===== UART Configuration =====
CONFIG_UART_ISR_IN_IRAM=n
CONFIG_UART0_RXD_PIN=44
CONFIG_UART0_TXD_PIN=43

# ===== DISABLE UNUSED COMPONENTS (Fixes I2S error) =====
CONFIG_I2S_SUPPORTED=n
CONFIG_LCD_ENABLED=n
CONFIG_SOC_I2S_SUPPORTED=n
CONFIG_SOC_LCD_RGB_SUPPORTED=n
CONFIG_SOC_PARLIO_SUPPORTED=n
CONFIG_PARLIO_ENABLED=n

# ===== Bluetooth & WiFi (Disabled) =====
CONFIG_BT_ENABLED=n
CONFIG_WIFI_ENABLED=n

# ===== PSRAM (Disabled - N4R2 has no PSRAM) =====
CONFIG_SPIRAM_SUPPORT=n

# ===== Tasks =====
CONFIG_SYSTEM_EVENT_TASK_STACK_SIZE=2048
CONFIG_TIMER_TASK_STACK_SIZE=2048
CONFIG_IDLE_TASK_STACKSIZE=2048

# ===== Debug =====
CONFIG_COMPILER_CXX_EXCEPTIONS=y
CONFIG_COMPILER_STACK_CHECK_MODE_STRONG=y
CONFIG_ESP_ERR_TO_NAME_LOOKUP=y

# ===== Minimal Core Configuration =====
CONFIG_MAIN_TASK_STACK_SIZE=4096
CONFIG_MINIMAL_HEAP_FRAGMENTATION=y

# ===== Reduce Binary Size =====
CONFIG_COMPILER_OPTIMIZATION_DEFAULT=y
CONFIG_COMPILER_OPTIMIZATION_SIZE=y
```
